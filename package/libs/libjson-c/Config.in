## package/libs/libjson-c/Config.in
```kconfig
# Choose libjson version.

choice
	prompt "libjson Version" if PACKAGE_libjson
	default LIBJSON_VERSION_0_13_1 if PACKAGE_libjson
	help
	  Select the version of libjson you wish to use.

	config LIBJSON_VERSION_0_13_1
		depends on PACKAGE_libjson
		bool "libjson 0.13.1"

	config LIBJSON_VERSION_0_12
		depends on PACKAGE_libjson
		bool "libjson 0.12"
endchoice

config LIBJSON_VERSION
	string
	default "0.13.1"       if LIBJSON_VERSION_0_13_1
	default "0.12"         if LIBJSON_VERSION_0_12
```

## package/libs/openssl/Config.in
```kconfig
if PACKAGE_libopenssl

comment "Build Options"

choice
	prompt "Openssl Version"
	default OPENSSL_VERSION_1_1_1b if TARGET_brcm963xx && !BRCM963xx_SDK_VER_416L02A && !BRCM963xx_SDK_VER_416L05 && !BRCM963xx_SDK_VER_502L04
	default OPENSSL_VERSION_1_0_2n
	help
		Select OpenSSL version.

	config OPENSSL_VERSION_1_0_2n
		depends on PACKAGE_libopenssl
		bool "Openssl 1.0.2n"

	config OPENSSL_VERSION_1_1_1b
		depends on PACKAGE_libopenssl
		bool "Openssl 1.1.1b"
endchoice

config OPENSSL_VERSION
	string
	default "1.0.2n"       if OPENSSL_VERSION_1_0_2n
	default "1.1.1b"       if OPENSSL_VERSION_1_1_1b

if OPENSSL_VERSION_1_0_2n
source "package/libs/openssl/Config-1.0.2n.in"
endif

if OPENSSL_VERSION_1_1_1b
source "package/libs/openssl/Config-1.1.1b.in"
endif

endif
```

## package/lxc/Config.in
```kconfig
menu "Configuration"
    depends on PACKAGE_lxc

    config LXC_KERNEL_OPTIONS
        bool "Enable kernel support for LXC"
        default n if !PACKAGE_lxc
        default y if PACKAGE_lxc
        select KERNEL_CGROUPS
        select KERNEL_NAMESPACES
        select KERNEL_LXC_MISC
        select KERNEL_MEMCG
        select KERNEL_CGROUP_SCHED
        select KERNEL_FAIR_GROUP_SCHED
        select KERNEL_CFS_BANDWIDTH
        select KERNEL_RT_GROUP_SCHED
        select KERNEL_CGROUP_CPUACCT
        select KERNEL_MEMCG
        select KERNEL_MEMCG_SWAP
        select KERNEL_MEMCG_KMEM
        select KERNEL_CPUSETS
        #select PACKAGE_kmod-ikconfig
        help
            Select needed kernel options for LXC related utilities. Options
            include cgroups, namespaces and other miscellaneous options. These
            options unfortunately can not be installed as a module.

endmenu
```

## package/network/services/net-snmp/Config.in
```kconfig
menu "Configuration"
    depends on PACKAGE_net-snmp && ZYXEL_MODSW_ZYEE

config NETSNMP_MODSW
    bool "net-snmp-modsw"
    default n
    help
        If enable the feature, the net-snmp package would NOT
        be installed into rootfs. If unsure, choose the default N.

endmenu
```
